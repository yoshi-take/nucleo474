//**************************************************
// インクルードファイル（include）
//**************************************************
#include <hal/hal_battery.h>		// BATT
#include "main.h"
#include "typedefine.h"				// 型定義
#include <stdio.h>

#include "hal/hal_led.h"			// LED
#include "hal/hal_spk.h"			// SPK

//**************************************************
// 定義（define）
//**************************************************
#define	BAT_LOW			(3600.0f)		// 残量やばい：3.6V(1cell)

//**************************************************
// 列挙体（enum）
//**************************************************

//**************************************************
// 構造体（struct）
//**************************************************

//**************************************************
// グローバル変数
//**************************************************
USHORT us_BatLvAve	= 0;		// バッテリー電圧平均値

//**************************************************
// プロトタイプ宣言（ファイル内で必要なものだけ記述）
//**************************************************

PUBLIC void hal_ADC3Start(void){
	 LL_ADC_Enable(ADC3);
}

PUBLIC USHORT hal_ADC3SingleConversion(void){
	USHORT data;
	LL_ADC_REG_StartConversion(ADC3);
	while(LL_ADC_IsActiveFlag_EOC(ADC3) ==0 ){
		// 変換待ち
	}
	LL_ADC_ClearFlag_EOC(ADC3);
	data	= LL_ADC_REG_ReadConversionData12(ADC3);

	return data;
}

// *************************************************************************
//   機能		： バッテリ電圧を取得を開始
//   注意		： なし
//   メモ		： ADC3のスタート
//   引数		： なし
//   返り値	： 電圧[mV]
// **************************    履    歴    *******************************
// 		v1.0		2020.12.13			TKR			新規
// *************************************************************************/
PUBLIC	void BAT_init(void){
	LL_ADC_Enable(ADC3);
}

// *************************************************************************
//   機能		： バッテリ電圧を取得する
//   注意		： なし
//   メモ		： なし
//   引数		： なし
//   返り値	： 電圧[mV]
// **************************    履    歴    *******************************
// 		v1.0		2019.4.2			TKR			新規
// *************************************************************************/
PUBLIC FLOAT BAT_getLv( void ){

	FLOAT f_val		= (FLOAT)( us_BatLvAve + 1 );

	return ( f_val / 4096 * 3300 * 2.0f );			// 2^12 * 3300[mV] * 2倍（抵抗比）
}

// *************************************************************************
//   機能		： バッテリ監視用ポーリング関数
//   注意		： なし
//   メモ		： 割り込みから実行される
//   引数		： なし
//   返り値	： なし
// **************************    履    歴    *******************************
// 		v1.0		2019.2.5			TKR			新規
// *************************************************************************/
PUBLIC void BAT_Pol( void )
{

	static	USHORT	us_BatLv[5] = { 4095, 4095, 4095, 4095, 4095 };		// バッテリレベル
	FLOAT	f_temp	= 0;

	/*  平均値を取得するため、データのバッファ処理を行う  */
	us_BatLv[4] = us_BatLv[3];
	us_BatLv[3] = us_BatLv[2];
	us_BatLv[2] = us_BatLv[1];
	us_BatLv[1] = us_BatLv[0];

	/* 最新の値を格納 */
	LL_ADC_REG_StartConversion(ADC3);
	while(LL_ADC_IsActiveFlag_EOC(ADC3) ==0 ){
		// 変換待ち
	}
	LL_ADC_ClearFlag_EOC(ADC3);
	us_BatLv[0]	= LL_ADC_REG_ReadConversionData12(ADC3);

	/* 電圧平均化 */
	us_BatLvAve = ( us_BatLv[0] + us_BatLv[1] + us_BatLv[2] + us_BatLv[3] + us_BatLv[4] ) / 5;

	/*  残量に応じてLEDを表示  */
	if( f_temp < BAT_LOW )SPK_alert();

}

// *************************************************************************
//   機能		： バッテリ電圧を表示する
//   注意		： なし
//   メモ		： 割り込みから実行される
//   引数		： なし
//   返り値		： なし
// **************************    履    歴    *******************************
// 		v1.0		2019.2.5			TKR			新規
// *************************************************************************/
PUBLIC void BAT_Check(void){

	LED_onAll();

	while(1){
		printf("[電源電圧] %5.2f[V]\n\r",BAT_getLv()/1000);
		LL_mDelay(500);
	}

}
